## utils/toolchain/aarch64_buildroot_toolchain_defconfig
```kconfig
BR2_aarch64=y
BR2_TOOLCHAIN_BUILDROOT=y
BR2_TOOLCHAIN_BUILDROOT_GLIBC=y
BR2_TOOLCHAIN_BUILDROOT_CXX=y
BR2_INSTALL_LIBSTDCPP=y
```

## utils/toolchain/riscv_buildroot_defconfig
```kconfig
#
# Architecture
#
BR2_riscv=y
BR2_riscv_custom=y
BR2_RISCV_ISA_CUSTOM_RVM=y
BR2_RISCV_ISA_CUSTOM_RVF=y
BR2_RISCV_ISA_CUSTOM_RVD=y
BR2_RISCV_ISA_CUSTOM_RVC=y
BR2_RISCV_ISA_SUPM=n
BR2_RISCV_ABI_LP64D=y
BR2_CCACHE=y

BR2_CONFIG_CMDLINE="rdinit=/bin/sh init=/bin/sh"
BR2_CONFIG_CMDLINE_EXTEND=y

#
# Toolchain to build rootfs
#
BR2_TOOLCHAIN_EXTERNAL=y
BR2_TOOLCHAIN_EXTERNAL_PATH="$(RISCV)"
BR2_TOOLCHAIN_EXTERNAL_CUSTOM_PREFIX="$(ARCH)-unknown-linux-gnu"
BR2_TOOLCHAIN_EXTERNAL_GCC_14=y
BR2_TOOLCHAIN_GCC_AT_LEAST="14"
BR2_TOOLCHAIN_EXTERNAL_HEADERS_6_6=y
BR2_TOOLCHAIN_EXTERNAL_CUSTOM_GLIBC=y
BR2_TOOLCHAIN_EXTERNAL_CXX=y
BR2_TOOLCHAIN_EXTERNAL_FORTRAN=y
BR2_TOOLCHAIN_EXTERNAL_HAS_SSP=y
BR2_TOOLCHAIN_EXTERNAL_OPENMP=y
BR2_TOOLCHAIN_EXTERNAL_INET_RPC=n
BR2_TOOLCHAIN_EXTERNAL_SUPM=n

#
# Rootfs
#
BR2_TARGET_GENERIC_HOSTNAME="esp"
BR2_TARGET_GENERIC_ISSUE="Welcome to ESP"
BR2_TARGET_ENABLE_ROOT_LOGIN=y
BR2_TARGET_GENERIC_ROOT_PASSWD=""
BR2_TARGET_GENERIC_PASSWD_SHA256=n
BR2_TARGET_GENERIC_PASSWD_METHOD="md5"
BR2_ROOTFS_OVERLAY="$(SYSROOT)"
BR2_TARGET_ROOTFS_CPIO=y
BR2_TARGET_ROOTFS_CPIO_NONE=y

#
# Busybox
#
BR2_PACKAGE_BUSYBOX_CONFIG="$(SCRIPT_PATH)/riscv_busybox.config"

#
# Networking
#
BR2_PACKAGE_ETHTOOL=y
BR2_PACKAGE_IPERF3=y
BR2_PACKAGE_IPROUTE2=y
BR2_PACKAGE_TCPDUMP=y
BR2_PACKAGE_DROPBEAR=y
BR2_PACKAGE_DROPBEAR_CLIENT=y
BR2_PACKAGE_DROPBEAR_SMALL=y
BR2_SYSTEM_DHCP="eth0"
BR2_PACKAGE_IFUPDOWN_SCRIPTS=y

#
# Extra
#
BR2_PACKAGE_HTOP=y
BR2_PACKAGE_DHRYSTONE=y
BR2_PACKAGE_MEMSTAT=y
BR2_PACKAGE_RAMSPEED=n
BR2_PACKAGE_NFS_UTILS=y
BR2_PACKAGE_LIBNFS=y

BR2_PARTITION_ADVANCED=y
BR2_OF_PARTITION=y
BR2_CONFIG_BPF=y
BR2_CONFIG_BPF_SYSCALL=y
BR2_CONFIG_BPF_JIT=y
```
