## socs/blitzcoin_asic_3x3/esp_defconfig
```kconfig
CPU_ARCH = ariane
NCPU_TILE = 1
CONFIG_HAS_SG = y
CONFIG_NOC_ROWS = 3
CONFIG_NOC_COLS = 3
CONFIG_COH_NOC_WIDTH = 64
CONFIG_DMA_NOC_WIDTH = 64
#CONFIG_MULTICAST_NOC_EN is not set
CONFIG_MAX_MCAST_DESTS = 2
CONFIG_QUEUE_SIZE = 4
CONFIG_CACHE_EN = y
CONFIG_CACHE_RTL = y
#CONFIG_CACHE_SPANDEX is not set
CONFIG_CPU_CACHES = 512 4 1024 16
CONFIG_ACC_CACHES = 512 4
CONFIG_CACHE_LINE_SIZE = 128
CONFIG_SLM_KBYTES = 256
CONFIG_JTAG_EN = y
CONFIG_ETH_EN = y
CONFIG_IOLINK_EN = y
CONFIG_IOLINK_WIDTH = 16
CONFIG_MEM_LINK_WIDTH = 64
#CONFIG_SVGA_EN is not set
CONGIG_DSU_IP = C0A80113
CONGIG_DSU_ETH = A6A7A0F81440
CONFIG_CLK_STR = 0
#CONFIG_MON_DDR is not set
#CONFIG_MON_MEM is not set
#CONFIG_MON_INJ is not set
#CONFIG_MON_ROUTERS is not set
#CONFIG_MON_ACCELERATORS is not set
#CONFIG_MON_L2 is not set
#CONFIG_MON_LLC is not set
#CONFIG_MON_DVFS is not set
TILE_0_0 = 0 cpu cpu 0 0 0
TILE_0_1 = 1 misc IO 0 0 0
TILE_0_2 = 2 acc NV_NVDLA  0 1 nvidia
TILE_1_0 = 3 acc FFT2_STRATUS basic_fx32_dma64 0 1 sld
TILE_1_1 = 4 mem mem
TILE_1_2 = 5 acc VITDODEC_STRATUS basic_dma64 0 1 sld
TILE_2_0 = 6 acc FFT2_STRATUS basic_fx32_dma64 0 1 sld
TILE_2_1 = 7 acc VITDODEC_STRATUS basic_dma64 0 1 sld
TILE_2_2 = 8 acc FFT2_STRATUS basic_fx32_dma64 0 1 sld
CONFIG_HAS_DVFS = y
```

## socs/defconfig/esp_profpga-xc7v2000t_defconfig
```kconfig
CONFIG_HAS_SG = y
CONFIG_NOC_ROWS = 2
CONFIG_NOC_COLS = 2
CONFIG_CPU_CACHES = 256 8 256 16
CONFIG_ACC_CACHES = 256 8
#CONFIG_MON_DDR is not set
#CONFIG_MON_INJ is not set
#CONFIG_MON_ROUTERS is not set
#CONFIG_MON_ACCELERATORS is not set
#CONFIG_MON_L2 is not set
#CONFIG_MON_LLC is not set
#CONFIG_MON_DVFS is not set
TILE_0_0 = 0 mem_dbg mem_dbg 0 0 0
TILE_0_1 = 1 misc IO 0 0 0
TILE_1_0 = 2 cpu cpu 0 0 0
TILE_1_1 = 3 mem_lite mem_lite 0 0 0
#CONFIG_HAS_DVFS is not set
CONFIG_VF_POINTS = 4
POWER_0_0 = mem_dbg 0 0 0 0 0 0 0 0 0 0 0 0 
POWER_0_1 = IO 0 0 0 0 0 0 0 0 0 0 0 0 
POWER_1_0 = cpu 0 0 0 0 0 0 0 0 0 0 0 0 
POWER_1_1 = mem_lite 0 0 0 0 0 0 0 0 0 0 0 0 
```

## socs/defconfig/esp_profpga-xc7vx690t_defconfig
```kconfig
CONFIG_HAS_SG = y
CONFIG_NOC_ROWS = 2
CONFIG_NOC_COLS = 2
CONFIG_MON_DDR = y
#CONFIG_MON_INJ is not set
CONFIG_MON_ROUTERS = y
#CONFIG_MON_ACCELERATORS is not set
#CONFIG_MON_DVFS is not set
TILE_0_0 = 0 mem_dbg mem_dbg 0 0 0
TILE_0_1 = 1 misc IO 0 0 0
TILE_1_0 = 2 cpu cpu 0 0 0
TILE_1_1 = 3 mem_lite mem_lite 0 0 0
#CONFIG_HAS_DVFS is not set
CONFIG_VF_POINTS = 4
POWER_0_0 = mem_dbg 0 0 0 0 0 0 0 0 0 0 0 0 
POWER_0_1 = IO 0 0 0 0 0 0 0 0 0 0 0 0 
POWER_1_0 = cpu 0 0 0 0 0 0 0 0 0 0 0 0 
POWER_1_1 = mem_lite 0 0 0 0 0 0 0 0 0 0 0 0 
```

## socs/defconfig/esp_xilinx-vc707-xc7vx485t_defconfig
```kconfig
CPU_ARCH = leon3
CONFIG_HAS_SG = y
CONFIG_NOC_ROWS = 2
CONFIG_NOC_COLS = 2
CONFIG_CACHE_EN = y
CONFIG_CACHE_RTL = y
CONFIG_CPU_CACHES = 512 4 1024 16
CONFIG_ACC_CACHES = 512 4
#CONFIG_MON_DDR is not set
#CONFIG_MON_MEM is not set
#CONFIG_MON_INJ is not set
#CONFIG_MON_ROUTERS is not set
#CONFIG_MON_ACCELERATORS is not set
#CONFIG_MON_L2 is not set
#CONFIG_MON_LLC is not set
#CONFIG_MON_DVFS is not set
TILE_0_0 = 0 mem mem 0 0 0
TILE_0_1 = 1 cpu cpu 0 0 0
TILE_1_0 = 2 empty empty 0 0 0
TILE_1_1 = 3 misc IO 0 0 0
#CONFIG_HAS_DVFS is not set
CONFIG_VF_POINTS = 4
POWER_0_0 = mem 0 0 0 0 0 0 0 0 0 0 0 0 
POWER_0_1 = cpu 0 0 0 0 0 0 0 0 0 0 0 0 
POWER_1_0 = empty 0 0 0 0 0 0 0 0 0 0 0 0 
POWER_1_1 = IO 0 0 0 0 0 0 0 0 0 0 0 0 
```

## socs/epochs0-gf12/esp_epochs0_defconfig
```kconfig
CPU_ARCH = ariane
NCPU_TILE = 4
CONFIG_HAS_SG = y
CONFIG_NOC_ROWS = 4
CONFIG_NOC_COLS = 4
CONFIG_COH_NOC_WIDTH = 64
CONFIG_DMA_NOC_WIDTH = 64
#CONFIG_MUTLICAST_NOC_EN is not set
CONFIG_MAX_MULTICAST_DESTS = 2
CONFIG_QUEUE_SIZE = 4
CONFIG_CACHE_EN = y
CONFIG_CACHE_RTL = y
#CONFIG_CACHE_SPANDEX is not set
CONFIG_CPU_CACHES = 512 4 2048 16
CONFIG_ACC_CACHES = 512 4
CONFIG_CACHE_LINE_SIZE = 128
CONFIG_SLM_KBYTES = 256
CONFIG_JTAG_EN = y
CONFIG_ETH_EN = y
#CONFIG_IOLINK_EN is not set
CONFIG_IOLINK_WIDTH = 16
CONFIG_MEM_LINK_WIDTH = 64
#CONFIG_SVGA_EN is not set
CONFIG_DSU_IP = C0A80113
CONFIG_DSU_ETH = A6A7A0F81440
#CONFIG_MON_DDR is not set
#CONFIG_MON_MEM is not set
#CONFIG_MON_INJ is not set
#CONFIG_MON_ROUTERS is not set
#CONFIG_MON_ACCELERATORS is not set
#CONFIG_MON_L2 is not set
#CONFIG_MON_LLC is not set
#CONFIG_MON_DVFS is not set
TILE_0_0 = 0 misc IO
TILE_0_1 = 1 acc NV_NVDLA  0 0 nvidia
TILE_0_2 = 2 acc NV_NVDLA  0 0 nvidia
TILE_0_3 = 3 acc NV_NVDLA  0 0 nvidia
TILE_1_0 = 4 acc FFT_STRATUS basic_fx32_dma64 0 0 sld
TILE_1_1 = 5 cpu cpu
TILE_1_2 = 6 cpu cpu
TILE_1_3 = 7 mem mem
TILE_2_0 = 8 acc FFT_STRATUS basic_fx32_dma64 0 0 sld
TILE_2_1 = 9 cpu cpu
TILE_2_2 = 10 cpu cpu
TILE_2_3 = 11 mem mem
TILE_3_0 = 12 acc FFT_STRATUS basic_fx32_dma64 0 0 sld
TILE_3_1 = 13 mem mem
TILE_3_2 = 14 mem mem
TILE_3_3 = 15 acc VITDODEC_STRATUS basic_dma64 0 0 sld
#CONFIG_HAS_DVFS is not set
```

## socs/esp_asic_generic/esp_defconfig
```kconfig
CPU_ARCH = ariane
NCPU_TILE = 1
CONFIG_HAS_SG = y
CONFIG_NOC_ROWS = 2
CONFIG_NOC_COLS = 2
CONFIG_COH_NOC_WIDTH = 64
CONFIG_DMA_NOC_WIDTH = 64
#CONFIG_MULTICAST_NOC_EN is not set
CONFIG_MAX_MCAST_DESTS = 2
CONFIG_CACHE_EN = y
CONFIG_CACHE_RTL = y
#CONFIG_CACHE_SPANDEX is not set
CONFIG_CPU_CACHES = 512 4 1024 16
CONFIG_ACC_CACHES = 512 4
CONFIG_CACHE_LINE_SIZE = 128
CONFIG_SLM_KBYTES = 256
CONFIG_JTAG_EN = y
CONFIG_ETH_EN = y
CONFIG_IOLINK_EN = y
CONFIG_IOLINK_WIDTH = 16
CONFIG_MEM_LINK_WIDTH = 64
#CONFIG_SVGA_EN is not set
CONGIG_DSU_IP = C0A80113
CONGIG_DSU_ETH = A6A7A0F81440
CONFIG_CLK_STR = 0
#CONFIG_MON_DDR is not set
#CONFIG_MON_MEM is not set
#CONFIG_MON_INJ is not set
#CONFIG_MON_ROUTERS is not set
#CONFIG_MON_ACCELERATORS is not set
#CONFIG_MON_L2 is not set
#CONFIG_MON_LLC is not set
#CONFIG_MON_DVFS is not set
TILE_0_0 = 0 misc IO 0 0 0
TILE_0_1 = 1 cpu cpu 0 0 0
TILE_1_0 = 2 acc NV_NVDLA 0 0 0  0 nvidia
TILE_1_1 = 3 mem mem 0 0 0
#CONFIG_HAS_DVFS is not set
CONFIG_VF_POINTS = 4
POWER_0_0 = IO 0 0 0 0 0 0 0 0 0 0 0 0 
POWER_0_1 = cpu 0 0 0 0 0 0 0 0 0 0 0 0 
POWER_1_0 = NV_NVDLA 0.0 0.0 0.0 0.0 0.0 0.0 0.0 0.0 0.0 0.0 0.0 0.0 
POWER_1_1 = mem 0 0 0 0 0 0 0 0 0 0 0 0 
```

## utils/scripts/riscv_buildroot_defconfig
```kconfig
BR2_riscv=y
BR2_riscv_custom=y
BR2_RISCV_ISA_CUSTOM_RVM=y
BR2_RISCV_ISA_CUSTOM_RVF=y
BR2_RISCV_ISA_CUSTOM_RVD=y
BR2_RISCV_ISA_CUSTOM_RVC=y
BR2_RISCV_ABI_LP64D=y
BR2_CCACHE=y
BR2_TOOLCHAIN_EXTERNAL=y
BR2_TOOLCHAIN_EXTERNAL_PATH="$(RISCV)"
BR2_TOOLCHAIN_EXTERNAL_CUSTOM_PREFIX="$(ARCH)-unknown-linux-gnu"
BR2_TOOLCHAIN_EXTERNAL_GCC_8=y
BR2_TOOLCHAIN_EXTERNAL_HEADERS_4_13=y
BR2_TOOLCHAIN_EXTERNAL_CUSTOM_GLIBC=y
BR2_TOOLCHAIN_EXTERNAL_CXX=y
BR2_ROOTFS_OVERLAY="$(SYSROOT)"
BR2_PACKAGE_BUSYBOX_CONFIG="$(SCRIPT_PATH)/riscv_busybox.config"
BR2_PACKAGE_DHRYSTONE=y
BR2_PACKAGE_MEMSTAT=y
BR2_PACKAGE_RAMSPEED=y
# BR2_PACKAGE_NFS_UTILS=y
# BR2_PACKAGE_LIBNFS=y
BR2_PACKAGE_ETHTOOL=y
# BR2_PACKAGE_IFUPDOWN_SCRIPTS is not set
BR2_PACKAGE_IPERF3=y
BR2_PACKAGE_IPROUTE2=y
BR2_PACKAGE_OPENSSH=y
BR2_PACKAGE_TCPDUMP=y
BR2_TARGET_ROOTFS_CPIO=y
# BR2_TARGET_ROOTFS_INITRAMFS=y
# BR2_TARGET_ROOTFS_TAR is not set
```

## utils/toolchain/leon3_buildroot_defconfig
```kconfig
#
# Architecture
#
BR2_sparc=y
BR2_ARCH="sparc"
BR2_ENDIAN="BIG"
BR2_GCC_TARGET_CPU="leon3"
BR2_BINFMT_SUPPORTS_SHARED=y
BR2_READELF_ARCH_NAME="Sparc"
BR2_BINFMT_ELF=y
BR2_sparc_leon3=y
BR2_CCACHE=y
BR2_ARCH_HAS_MMU_MANDATORY=y

#
# Toolchain to build rootfs
#
BR2_TOOLCHAIN_EXTERNAL=y
BR2_TOOLCHAIN_EXTERNAL_PATH="$(LEON)"
BR2_TOOLCHAIN_EXTERNAL_CUSTOM_PREFIX="$(ARCH)-linux"
BR2_TOOLCHAIN_EXTERNAL_GCC_5=y
BR2_TOOLCHAIN_EXTERNAL_HEADERS_4_9=y
BR2_TOOLCHAIN_EXTERNAL_OPENMP=y
BR2_TOOLCHAIN_EXTERNAL_WCHAR=y
BR2_TOOLCHAIN_EXTERNALo_HAS_THREADS=y
# BR2_TOOLCHAIN_EXTERNAL_HAS_THREADS_DEBUG is not set
BR2_TOOLCHAIN_EXTERNAL_HAS_THREADS_NPTL=y
BR2_TOOLCHAIN_EXTERNAL_UCLIBC=y
BR2_TOOLCHAIN_EXTERNAL_CXX=y

#
# Rootfs
#
BR2_ROOTFS_SKELETON_DEFAULT=y
BR2_TARGET_GENERIC_HOSTNAME="esp"
BR2_TARGET_GENERIC_ISSUE="Welcome to ESP"
BR2_TARGET_ENABLE_ROOT_LOGIN=y
BR2_TARGET_GENERIC_ROOT_PASSWD="openesp"
BR2_TARGET_GENERIC_PASSWD_MD5=y
BR2_TARGET_GENERIC_PASSWD_METHOD="md5"
BR2_SYSTEM_BIN_SH_BUSYBOX=y
BR2_ROOTFS_DEVICE_CREATION_DYNAMIC_DEVTMPFS=y
BR2_ROOTFS_OVERLAY="$(SYSROOT)"
BR2_TARGET_ROOTFS_CPIO=y
BR2_TARGET_ROOTFS_CPIO_NONE=y

BR2_TARGET_GENERIC_GETTY=y
BR2_TARGET_GENERIC_GETTY_PORT="console"
BR2_TARGET_GENERIC_GETTY_BAUDRATE_KEEP=y
BR2_TARGET_GENERIC_GETTY_BAUDRATE="0"
BR2_TARGET_GENERIC_GETTY_TERM="vt100"
BR2_TARGET_GENERIC_GETTY_OPTIONS=""

#
# Busybox
#
BR2_PACKAGE_BUSYBOX=y
BR2_PACKAGE_BUSYBOX_CONFIG="$(SCRIPT_PATH)/leon3_busybox.config"
BR2_INIT_BUSYBOX=y

#
# Extra libraries
#
BR2_PACKAGE_NCURSES=y
BR2_PACKAGE_PROVIDES_HOST_ZLIB="host-libzlib"
BR2_PACKAGE_PROVIDES_HOST_OPENSSL="host-libopenssl"
BR2_PACKAGE_LIBCAP=y

#
# Networking
#
BR2_PACKAGE_ETHTOOL=y
BR2_PACKAGE_IPERF3=y
BR2_PACKAGE_IPROUTE2=y
BR2_PACKAGE_TCPDUMP=y
BR2_PACKAGE_DROPBEAR=y
BR2_PACKAGE_DROPBEAR_CLIENT=y
BR2_PACKAGE_DROPBEAR_SMALL=y
BR2_SYSTEM_DHCP="eth0"
BR2_PACKAGE_IFUPDOWN_SCRIPTS=y

#
# Extra
#
BR2_PACKAGE_HTOP=y
BR2_PACKAGE_INITSCRIPTS=y
BR2_PACKAGE_UEMACS=y
BR2_PACKAGE_HOST_MKPASSWD=y
BR2_PACKAGE_HOST_PATCHELF=y
```

## utils/toolchain/leon3_buildroot_toolchain_defconfig
```kconfig
#
# Architecture
#
BR2_sparc=y
BR2_ARCH="sparc"
BR2_ENDIAN="BIG"
BR2_GCC_TARGET_CPU="leon3"
BR2_BINFMT_SUPPORTS_SHARED=y
BR2_READELF_ARCH_NAME="Sparc"
BR2_BINFMT_ELF=y
BR2_sparc_leon3=y
BR2_CCACHE=y
BR2_ARCH_HAS_MMU_MANDATORY=y

#
# Rootfs
#
BR2_ROOTFS_SKELETON_DEFAULT=y
BR2_TARGET_GENERIC_HOSTNAME="esp"
BR2_TARGET_GENERIC_ISSUE="Welcome to ESP"
BR2_TARGET_ENABLE_ROOT_LOGIN=y
BR2_TARGET_GENERIC_ROOT_PASSWD="openesp"
BR2_TARGET_GENERIC_PASSWD_MD5=y
BR2_TARGET_GENERIC_PASSWD_METHOD="md5"
BR2_SYSTEM_BIN_SH_BUSYBOX=y
BR2_ROOTFS_DEVICE_CREATION_DYNAMIC_DEVTMPFS=y
BR2_ROOTFS_OVERLAY="$(SYSROOT)"
BR2_TARGET_ROOTFS_CPIO=y
BR2_TARGET_ROOTFS_CPIO_NONE=y

BR2_TARGET_GENERIC_GETTY=y
BR2_TARGET_GENERIC_GETTY_PORT="console"
BR2_TARGET_GENERIC_GETTY_BAUDRATE_KEEP=y
BR2_TARGET_GENERIC_GETTY_BAUDRATE="0"
BR2_TARGET_GENERIC_GETTY_TERM="vt100"
BR2_TARGET_GENERIC_GETTY_OPTIONS=""

#
# Busybox
#
BR2_PACKAGE_BUSYBOX=y
BR2_PACKAGE_BUSYBOX_CONFIG="$(SCRIPT_PATH)/leon3_busybox.config"
BR2_INIT_BUSYBOX=y
BR2_PACKAGE_BUSYBOX_CONFIG_FRAGMENT_FILES=""
BR2_PACKAGE_SKELETON=y
BR2_PACKAGE_HAS_SKELETON=y
BR2_PACKAGE_PROVIDES_SKELETON="skeleton-init-sysv"
BR2_PACKAGE_SKELETON_INIT_COMMON=y
BR2_PACKAGE_SKELETON_INIT_SYSV=y


#
# Extra libraries
#
BR2_PACKAGE_NCURSES=y
BR2_PACKAGE_PROVIDES_HOST_ZLIB="host-libzlib"
BR2_PACKAGE_PROVIDES_HOST_OPENSSL="host-libopenssl"
BR2_PACKAGE_LIBCAP=y

#
# Networking
#
BR2_PACKAGE_ETHTOOL=y
BR2_PACKAGE_IPERF3=y
BR2_PACKAGE_IPROUTE2=y
BR2_PACKAGE_TCPDUMP=y
BR2_PACKAGE_DROPBEAR=y
BR2_PACKAGE_DROPBEAR_CLIENT=y
BR2_PACKAGE_DROPBEAR_SMALL=y
BR2_SYSTEM_DHCP="eth0"
BR2_PACKAGE_IFUPDOWN_SCRIPTS=y

#
# Extra
#
BR2_PACKAGE_HTOP=y
BR2_PACKAGE_INITSCRIPTS=y
BR2_PACKAGE_UEMACS=y
BR2_PACKAGE_HOST_MKPASSWD=y
BR2_PACKAGE_HOST_PATCHELF=y


#
# Building the toolchain
#
BR2_HOST_DIR="$(LEON)"
BR2_TOOLCHAIN=y
BR2_TOOLCHAIN_USES_UCLIBC=y
BR2_TOOLCHAIN_BUILDROOT=y
BR2_KERNEL_HEADERS_CUSTOM_GIT=y
BR2_KERNEL_HEADERS_CUSTOM_REPO_URL="https://github.com/sld-columbia/linux.git"
BR2_KERNEL_HEADERS_CUSTOM_REPO_VERSION="5a7ba4bb1e43837226e02928fde72241e2426cfb"
BR2_PACKAGE_HOST_LINUX_HEADERS_CUSTOM_4_9=y
BR2_SHARED_LIBS=y
BR2_PACKAGE_UCLIBC=y
BR2_TOOLCHAIN_BUILDROOT_UCLIBC=y
BR2_UCLIBC_CONFIG="package/uclibc/uClibc-ng.config"
BR2_UCLIBC_CONFIG_FRAGMENT_FILES=""
BR2_TOOLCHAIN_BUILDROOT_WCHAR=y
BR2_PTHREADS_NATIVE=y
BR2_UCLIBC_INSTALL_UTILS=y
BR2_UCLIBC_TARGET_ARCH="sparc"
BR2_TOOLCHAIN_BUILDROOT_VENDOR="leon3"
BR2_TOOLCHAIN_BUILDROOT_LIBC=""

#
# Binutils Options
#
BR2_PACKAGE_HOST_BINUTILS_SUPPORTS_CFI=y
BR2_BINUTILS_VERSION_2_32_X=y
BR2_BINUTILS_VERSION="2.32"
BR2_BINUTILS_EXTRA_CONFIG_OPTIONS=""

#
# GCC Options
#
BR2_GCC_VERSION_5_X=y
BR2_GCC_VERSION="5.5.0"
BR2_GCC_ENABLE_OPENMP=y
BR2_GCC_SUPPORTS_LIBCILKRTS=y
BR2_EXTRA_GCC_CONFIG_OPTIONS=""
BR2_TOOLCHAIN_BUILDROOT_CXX=y

#
# Toolchain Generic Options
#
BR2_TOOLCHAIN_SUPPORTS_ALWAYS_LOCKFREE_ATOMIC_INTS=y
BR2_TOOLCHAIN_SUPPORTS_VARIADIC_MI_THUNK=y
BR2_USE_WCHAR=y
BR2_INSTALL_LIBSTDCPP=y
BR2_TOOLCHAIN_HAS_THREADS=y
BR2_TOOLCHAIN_HAS_THREADS_NPTL=y
BR2_TOOLCHAIN_HAS_UCONTEXT=y
BR2_TOOLCHAIN_HAS_OPENMP=y
BR2_TOOLCHAIN_SUPPORTS_PIE=y
BR2_TOOLCHAIN_EXTRA_LIBS=""
BR2_USE_MMU=y
BR2_TARGET_OPTIMIZATION=""
BR2_TARGET_LDFLAGS=""
BR2_TOOLCHAIN_HEADERS_AT_LEAST_3_0=y
BR2_TOOLCHAIN_HEADERS_AT_LEAST_3_1=y
BR2_TOOLCHAIN_HEADERS_AT_LEAST_3_2=y
BR2_TOOLCHAIN_HEADERS_AT_LEAST_3_3=y
BR2_TOOLCHAIN_HEADERS_AT_LEAST_3_4=y
BR2_TOOLCHAIN_HEADERS_AT_LEAST_3_5=y
BR2_TOOLCHAIN_HEADERS_AT_LEAST_3_6=y
BR2_TOOLCHAIN_HEADERS_AT_LEAST_3_7=y
BR2_TOOLCHAIN_HEADERS_AT_LEAST_3_8=y
BR2_TOOLCHAIN_HEADERS_AT_LEAST_3_9=y
BR2_TOOLCHAIN_HEADERS_AT_LEAST_3_10=y
BR2_TOOLCHAIN_HEADERS_AT_LEAST_3_11=y
BR2_TOOLCHAIN_HEADERS_AT_LEAST_3_12=y
BR2_TOOLCHAIN_HEADERS_AT_LEAST_3_13=y
BR2_TOOLCHAIN_HEADERS_AT_LEAST_3_14=y
BR2_TOOLCHAIN_HEADERS_AT_LEAST_3_15=y
BR2_TOOLCHAIN_HEADERS_AT_LEAST_3_16=y
BR2_TOOLCHAIN_HEADERS_AT_LEAST_3_17=y
BR2_TOOLCHAIN_HEADERS_AT_LEAST_3_18=y
BR2_TOOLCHAIN_HEADERS_AT_LEAST_3_19=y
BR2_TOOLCHAIN_HEADERS_AT_LEAST_4_0=y
BR2_TOOLCHAIN_HEADERS_AT_LEAST_4_1=y
BR2_TOOLCHAIN_HEADERS_AT_LEAST_4_2=y
BR2_TOOLCHAIN_HEADERS_AT_LEAST_4_3=y
BR2_TOOLCHAIN_HEADERS_AT_LEAST_4_4=y
BR2_TOOLCHAIN_HEADERS_AT_LEAST_4_5=y
BR2_TOOLCHAIN_HEADERS_AT_LEAST_4_6=y
BR2_TOOLCHAIN_HEADERS_AT_LEAST_4_7=y
BR2_TOOLCHAIN_HEADERS_AT_LEAST_4_8=y
BR2_TOOLCHAIN_HEADERS_AT_LEAST_4_9=y
BR2_TOOLCHAIN_HEADERS_AT_LEAST="4.9"
BR2_TOOLCHAIN_GCC_AT_LEAST_4_3=y
BR2_TOOLCHAIN_GCC_AT_LEAST_4_4=y
BR2_TOOLCHAIN_GCC_AT_LEAST_4_5=y
BR2_TOOLCHAIN_GCC_AT_LEAST_4_6=y
BR2_TOOLCHAIN_GCC_AT_LEAST_4_7=y
BR2_TOOLCHAIN_GCC_AT_LEAST_4_8=y
BR2_TOOLCHAIN_GCC_AT_LEAST_4_9=y
BR2_TOOLCHAIN_GCC_AT_LEAST_5=y
BR2_TOOLCHAIN_GCC_AT_LEAST_6=y
BR2_TOOLCHAIN_GCC_AT_LEAST_7=y
BR2_TOOLCHAIN_GCC_AT_LEAST_8=y
BR2_TOOLCHAIN_GCC_AT_LEAST="8"
BR2_TOOLCHAIN_HAS_MNAN_OPTION=y
BR2_TOOLCHAIN_HAS_LIBATOMIC=y
BR2_TOOLCHAIN_HAS_ATOMIC=y
```

## utils/toolchain/riscv_buildroot_python_defconfig
```kconfig
#
# Architecture
#
BR2_riscv=y
BR2_riscv_custom=y
BR2_RISCV_ISA_CUSTOM_RVM=y
BR2_RISCV_ISA_CUSTOM_RVF=y
BR2_RISCV_ISA_CUSTOM_RVD=y
BR2_RISCV_ISA_CUSTOM_RVC=y
BR2_RISCV_ABI_LP64D=y
BR2_CCACHE=y

#
# Toolchain to build rootfs
#
BR2_TOOLCHAIN_EXTERNAL=y
BR2_TOOLCHAIN_EXTERNAL_PATH="$(RISCV)"
BR2_TOOLCHAIN_EXTERNAL_CUSTOM_PREFIX="$(ARCH)-unknown-linux-gnu"
BR2_TOOLCHAIN_EXTERNAL_GCC_9=y
BR2_TOOLCHAIN_EXTERNAL_HEADERS_5_0=y
BR2_TOOLCHAIN_EXTERNAL_CUSTOM_GLIBC=y
BR2_TOOLCHAIN_EXTERNAL_CXX=y

#
# Rootfs
#
BR2_TARGET_GENERIC_HOSTNAME="esp"
BR2_TARGET_GENERIC_ISSUE="Welcome to ESP"
BR2_TARGET_ENABLE_ROOT_LOGIN=y
#BR2_TARGET_GENERIC_ROOT_PASSWD="openesp"
BR2_ROOTFS_OVERLAY="$(SYSROOT)"
BR2_TARGET_ROOTFS_CPIO=y
BR2_TARGET_ROOTFS_CPIO_NONE=y

#
# Busybox
#
BR2_PACKAGE_BUSYBOX_CONFIG="$(SCRIPT_PATH)/riscv_busybox_python.config"

#
# Networking
#
BR2_PACKAGE_ETHTOOL=y
BR2_PACKAGE_IPERF3=y
BR2_PACKAGE_IPROUTE2=y
BR2_PACKAGE_TCPDUMP=y
BR2_PACKAGE_DROPBEAR=y
BR2_PACKAGE_DROPBEAR_CLIENT=y
BR2_PACKAGE_DROPBEAR_SMALL=y
BR2_SYSTEM_DHCP="eth0"
BR2_PACKAGE_IFUPDOWN_SCRIPTS=y

#
# Extra
#
BR2_PACKAGE_HTOP=y
BR2_PACKAGE_DHRYSTONE=y
BR2_PACKAGE_MEMSTAT=y
BR2_PACKAGE_RAMSPEED=y
# BR2_PACKAGE_NFS_UTILS=y
# BR2_PACKAGE_LIBNFS=y


#
# Python 3
#

BR2_PACKAGE_PYTHON3=y
#BR2_PACKAGE_PYTHON3_PYC_ONLY=y
BR2_PACKAGE_PYTHON3_PY_PYC=y
BR2_PACKAGE_PYTHON_NUMPY_ARCH_SUPPORTS=y
BR2_PACKAGE_PYTHON_NUMPY=y
BR2_PACKAGE_PYTHON3_UNICODEDATA=y
BR2_PACKAGE_PYTHON3_PYEXPAT=y
BR2_PACKAGE_PYTHON3_ZLIB=y
BR2_PACKAGE_PYTHON_PIP=y
BR2_PACKAGE_PYTHON_SETUPTOOLS=y
BR2_PACKAGE_EXPAT=y
BR2_PACKAGE_LIBGPG_ERROR_ARCH_SUPPORTS=y
BR2_PACKAGE_JEMALLOC_ARCH_SUPPORTS=y
BR2_PACKAGE_LIBFFI=y
#BR2_PACKAGE_RNG_TOOLS=y
BR2_PACKAGE_HAVEGED=y
BR2_PACKAGE_PYTHON3_SSL=y
```
